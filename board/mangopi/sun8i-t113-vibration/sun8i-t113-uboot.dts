// SPDX-License-Identifier: (GPL-2.0+ OR MIT)
// Copyright (C) 2022 Arm Ltd.

/dts-v1/;

#include "mangopi-common-uboot.dtsi"

/ {
	chosen {
		stdout-path = "serial2:115200n8";
	};
};

&uart2 {
	status = "okay";
};
