// SPDX-License-Identifier: (GPL-2.0+ or MIT)
// Copyright (C) 2022 Samuel Holland <samuel@sholland.org>

/dts-v1/;

#include "mangopi-common.dtsi"

/ {
	compatible = "sun8i-t113-recovery";

	uboot,fastboot-pin = "always";

	chosen {
		stdout-path = "serial1:115200n8";
	};
};
