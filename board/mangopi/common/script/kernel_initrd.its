## configs/mangopi_sun8i_t113_vibration_defconfig
```kconfig
BR2_arm=y
BR2_cortex_a7=y
BR2_ARM_FPU_NEON_VFPV4=y
BR2_ARM_INSTRUCTIONS_THUMB2=y
BR2_TOOLCHAIN_EXTERNAL=y
BR2_TOOLCHAIN_EXTERNAL_GDB_SERVER_COPY=y
BR2_DL_DIR="$(TOPDIR)/../dl"
BR2_OPTIMIZE_2=y
BR2_TARGET_GENERIC_ISSUE="Welcome to VibrationNovaMonitor"
BR2_ROOTFS_DEVICE_CREATION_DYNAMIC_EUDEV=y
BR2_TARGET_GENERIC_ROOT_PASSWD="novanova"
BR2_TARGET_TZ_INFO=y
BR2_ROOTFS_OVERLAY="board/mangopi/common/overlay board/mangopi/sun8i-t113-vibration/overlay"
BR2_ROOTFS_POST_BUILD_SCRIPT="board/mangopi/common/script/post-build.sh"
BR2_ROOTFS_POST_IMAGE_SCRIPT="board/mangopi/common/script/genimage.sh"
BR2_ROOTFS_POST_SCRIPT_ARGS="-c board/mangopi/common/script/genimage.cfg"
BR2_LINUX_KERNEL=y
BR2_LINUX_KERNEL_CUSTOM_GIT=y
BR2_LINUX_KERNEL_CUSTOM_REPO_URL="https://github.com/Jookia/linux"
BR2_LINUX_KERNEL_CUSTOM_REPO_VERSION="5ff2450e1234f4e085578e440ded900a7069b322"
BR2_LINUX_KERNEL_PATCH="board/mangopi/common/linux-patches/"
BR2_LINUX_KERNEL_USE_CUSTOM_CONFIG=y
BR2_LINUX_KERNEL_CUSTOM_CONFIG_FILE="board/mangopi/sun8i-t113-vibration/linux.config"
BR2_LINUX_KERNEL_CONFIG_FRAGMENT_FILES="board/mangopi/common/linux.config"
BR2_LINUX_KERNEL_DTS_SUPPORT=y
BR2_LINUX_KERNEL_INTREE_DTS_NAME="sun8i-t113"
BR2_LINUX_KERNEL_CUSTOM_DTS_PATH="board/mangopi/common/mangopi-common.dtsi board/mangopi/sun8i-t113-vibration/sun8i-t113.dts"
BR2_LINUX_KERNEL_NEEDS_HOST_OPENSSL=y
BR2_PACKAGE_ALSA_UTILS=y
BR2_PACKAGE_ALSA_UTILS_AMIXER=y
BR2_PACKAGE_ALSA_UTILS_APLAY=y
BR2_PACKAGE_BZIP2=y
BR2_PACKAGE_GDB=y
BR2_PACKAGE_GDB_DEBUGGER=y
BR2_PACKAGE_STRACE=y
BR2_PACKAGE_STRESS=y
BR2_PACKAGE_VALGRIND=y
BR2_PACKAGE_MTD=y
BR2_PACKAGE_MTD_MKFSUBIFS=y
# BR2_PACKAGE_MTD_MTD_DEBUG is not set
# BR2_PACKAGE_MTD_NANDDUMP is not set
# BR2_PACKAGE_MTD_NANDTEST is not set
BR2_PACKAGE_MEMTESTER=y
BR2_PACKAGE_RTL8189FS=y
BR2_PACKAGE_USBMOUNT=y
BR2_PACKAGE_PYTHON3=y
BR2_PACKAGE_PYTHON3_PYEXPAT=y
BR2_PACKAGE_PYTHON_NUMPY=y
BR2_PACKAGE_PYTHON_OPCUA_ASYNCIO=y
BR2_PACKAGE_PYTHON_PYOPENSSL=y
BR2_PACKAGE_PYTHON_REQUESTS=y
BR2_PACKAGE_PYTHON_SORTEDCONTAINERS=y
BR2_PACKAGE_LIBGPIOD=y
BR2_PACKAGE_LIBGPIOD_TOOLS=y
BR2_PACKAGE_LIBGUDEV=y
BR2_PACKAGE_LIBV4L=y
BR2_PACKAGE_LIBV4L_UTILS=y
BR2_PACKAGE_OPEN62541=y
BR2_PACKAGE_OPEN62541_ENCRYPTION_OPENSSL=y
BR2_PACKAGE_OPEN62541_UA_NAMESPACE_ZERO_FULL=y
BR2_PACKAGE_OPEN62541_HISTORIZING=y
BR2_PACKAGE_RTMPDUMP=y
BR2_PACKAGE_LAPACK=y
BR2_PACKAGE_LIBPTHREAD_STUBS=y
BR2_PACKAGE_COLLECTD=y
BR2_PACKAGE_DROPBEAR=y
BR2_PACKAGE_DROPBEAR_DISABLE_REVERSEDNS=y
BR2_PACKAGE_GESFTPSERVER=y
BR2_PACKAGE_IPROUTE2=y
BR2_PACKAGE_NTP=y
BR2_PACKAGE_RSYNC=y
BR2_PACKAGE_VSFTPD=y
BR2_PACKAGE_WIRELESS_REGDB=y
BR2_PACKAGE_WIRELESS_TOOLS=y
BR2_PACKAGE_WPA_SUPPLICANT=y
BR2_PACKAGE_WPA_SUPPLICANT_AUTOSCAN=y
BR2_PACKAGE_WPA_SUPPLICANT_DEBUG_SYSLOG=y
BR2_PACKAGE_WPA_SUPPLICANT_CLI=y
BR2_PACKAGE_WPA_SUPPLICANT_PASSPHRASE=y
BR2_PACKAGE_WPAN_TOOLS=y
BR2_PACKAGE_HTOP=y
BR2_PACKAGE_MC=y
BR2_PACKAGE_NOVA_WI=y
BR2_TARGET_ROOTFS_CPIO=y
BR2_TARGET_ROOTFS_EXT2=y
BR2_TARGET_ROOTFS_EXT2_4=y
BR2_TARGET_ROOTFS_EXT2_SIZE="512M"
# BR2_TARGET_ROOTFS_TAR is not set
BR2_TARGET_ROOTFS_UBIFS=y
BR2_TARGET_ROOTFS_UBIFS_LEBSIZE=0x1f000
BR2_TARGET_ROOTFS_UBIFS_MAXLEBCNT=958
BR2_TARGET_ROOTFS_UBIFS_OPTS="-F"
BR2_TARGET_SK_BOOT_MMC0=y
BR2_TARGET_UBOOT=y
BR2_TARGET_UBOOT_BUILD_SYSTEM_KCONFIG=y
BR2_TARGET_UBOOT_CUSTOM_GIT=y
BR2_TARGET_UBOOT_CUSTOM_REPO_URL="https://github.com/Jookia/u-boot"
BR2_TARGET_UBOOT_CUSTOM_REPO_VERSION="9588458925221d2908d04210a2733ed991214b32"
BR2_TARGET_UBOOT_PATCH="board/mangopi/common/uboot-patches"
BR2_TARGET_UBOOT_USE_CUSTOM_CONFIG=y
BR2_TARGET_UBOOT_CUSTOM_CONFIG_FILE="board/mangopi/common/uboot.config"
BR2_TARGET_UBOOT_CONFIG_FRAGMENT_FILES="board/mangopi/sun8i-t113-vibration/uboot.config"
BR2_TARGET_UBOOT_NEEDS_PYTHON3=y
BR2_TARGET_UBOOT_NEEDS_OPENSSL=y
# BR2_TARGET_UBOOT_FORMAT_BIN is not set
BR2_TARGET_UBOOT_FORMAT_IMG=y
BR2_TARGET_UBOOT_SPL=y
BR2_TARGET_UBOOT_SPL_NAME="spl/sunxi-spl.bin"
BR2_TARGET_UBOOT_CUSTOM_DTS_PATH="board/mangopi/common/mangopi-common.dtsi board/mangopi/sun8i-t113-vibration/sun8i-t113.dts"
BR2_PACKAGE_HOST_DOSFSTOOLS=y
BR2_PACKAGE_HOST_GENIMAGE=y
BR2_PACKAGE_HOST_MTOOLS=y
BR2_PACKAGE_HOST_UBOOT_TOOLS=y
BR2_PACKAGE_HOST_UBOOT_TOOLS_FIT_SUPPORT=y
```

## package/nova-wi/Config.in
```kconfig
config BR2_PACKAGE_NOVA_WI
	bool "nova-wi"
	select BR2_PACKAGE_NGINX
	select BR2_PACKAGE_NGINX_HTTP
	select BR2_PACKAGE_NGINX_HTTP_SSL_MODULE
	select BR2_PACKAGE_NGINX_HTTP_AUTH_REQUEST_MODULE
	select BR2_PACKAGE_NGINX_HTTP_ACCESS_MODULE
	select BR2_PACKAGE_NGINX_HTTP_AUTH_BASIC_MODULE
	select BR2_PACKAGE_NGINX_HTTP_FASTCGI_MODULE
	select BR2_PACKAGE_FCGIWRAP
	select BR2_PACKAGE_LIBFCGI
	help
	  Web interface for T113ADC

	  https://github.com/Coxwain1987/t113_web_interface
```
