// SPDX-License-Identifier: (GPL-2.0+ or MIT)
// Copyright (C) 2022 Samuel Holland <samuel@sholland.org>

/dts-v1/;

#include "mangopi-common.dtsi"

/ {
	model = "MangoPi MQ-Dual MCD_2310";
	compatible = "allwinner,sun20i-d1", "allwinner,sun8i";

	chosen {
		stdout-path = "serial2:115200n8";
	};
};

&uart2 {
	status = "okay";
};
